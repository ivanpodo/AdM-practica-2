# file: practica-2.ioc
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Mcu.Family=STM32F4
Mcu.Name=STM32F429ZITx
Mcu.Package=LQFP144
NVIC.PriorityGroup=NVIC_PRIORITYGROUP_4
ProjectManager.HeapSize=0x200
ProjectManager.StackSize=0x400
ProjectManager.TargetToolchain=STM32CubeIDE
RCC.AHBFreq_Value=16000000
RCC.APB1Freq_Value=16000000
RCC.APB2Freq_Value=16000000
RCC.CortexFreq_Value=16000000
RCC.HSE_VALUE=25000000
RCC.HSI_VALUE=16000000
RCC.LSE_VALUE=32768
RCC.SYSCLKFreq_VALUE=16000000
RCC.VCOOutputFreq_Value=192000000
board=custom

// file: Core/Src/main.c
/* USER CODE BEGIN Header */
/**
  ******************************************************************************
  * @file           : main.c
  * @brief          : Main program body
  ******************************************************************************
  * @attention
  *
  * Copyright (c) 2024 STMicroelectronics.
  * All rights reserved.
  *
  * This software is licensed under terms that can be found in the LICENSE file
  * in the root directory of this software component.
  * If no LICENSE file comes with this software, it is provided AS-IS.
  *
  ******************************************************************************
  */
/* USER CODE END Header */
#include "main.h"

/* USER CODE BEGIN Includes */
#include "asm_func.h"
/* USER CODE END Includes */

void SystemClock_Config(void);
/* USER CODE BEGIN PFP */
void 	 pack32to16 (int32_t * vectorIn, int16_t * vectorOut, uint32_t longitud);
uint32_t max (int32_t * vectorIn, uint32_t longitud);
void 	 downSample (int32_t * vectorIn, int32_t * vectorOut, uint32_t longitud, uint32_t N);
void 	 invertir (uint16_t * vector, uint32_t longitud);

/* USER CODE END PFP */

int main(void)
{
  /* USER CODE BEGIN 1 */
	DWT->CTRL |= 1 << DWT_CTRL_CYCCNTENA_Pos;
	uint32_t ciclos_C, ciclos_ASM;
	int32_t vectorIn[] = {0xffff0000, 0xaaaa0000, 0xbbbb0000};
	int16_t vectorOut[3];

	DWT->CYCCNT = 0;
	pack32to16(vectorIn, vectorOut, 3);
	ciclos_C = DWT->CYCCNT; // 0xa7

	DWT->CYCCNT = 0;
	asm_pack32to16(vectorIn, vectorOut, 3);
	ciclos_ASM = DWT->CYCCNT; // 0x2a (~4 times more efective)

	(void)ciclos_C;		//to clean warning
	(void)ciclos_ASM;	//to clean warning

  /* USER CODE END 1 */

  /* MCU Configuration--------------------------------------------------------*/

  /* Reset of all peripherals, Initializes the Flash interface and the Systick. */
  HAL_Init();

  /* Configure the system clock */
  SystemClock_Config();

  /* Initialize all configured peripherals */

  /* Infinite loop */
  while (1)
  {

  }
}

void SystemClock_Config(void)
{
  RCC_OscInitTypeDef RCC_OscInitStruct = {0};
  RCC_ClkInitTypeDef RCC_ClkInitStruct = {0};

  /** Configure the main internal regulator output voltage
  */
  __HAL_RCC_PWR_CLK_ENABLE();
  __HAL_PWR_VOLTAGESCALING_CONFIG(PWR_REGULATOR_VOLTAGE_SCALE3);

  /** Initializes the RCC Oscillators according to the specified parameters
  * in the RCC_OscInitTypeDef structure.
  */
  RCC_OscInitStruct.OscillatorType = RCC_OSCILLATORTYPE_HSI;
  RCC_OscInitStruct.HSIState = RCC_HSI_ON;
  RCC_OscInitStruct.HSICalibrationValue = RCC_HSICALIBRATION_DEFAULT;
  RCC_OscInitStruct.PLL.PLLState = RCC_PLL_NONE;
  if (HAL_RCC_OscConfig(&RCC_OscInitStruct) != HAL_OK)
  {
    Error_Handler();
  }

  /** Initializes the CPU, AHB and APB buses clocks
  */
  RCC_ClkInitStruct.ClockType = RCC_CLOCKTYPE_HCLK|RCC_CLOCKTYPE_SYSCLK
                              |RCC_CLOCKTYPE_PCLK1|RCC_CLOCKTYPE_PCLK2;
  RCC_ClkInitStruct.SYSCLKSource = RCC_SYSCLKSOURCE_HSI;
  RCC_ClkInitStruct.AHBCLKDivider = RCC_SYSCLK_DIV1;
  RCC_ClkInitStruct.APB1CLKDivider = RCC_HCLK_DIV1;
  RCC_ClkInitStruct.APB2CLKDivider = RCC_HCLK_DIV1;

  if (HAL_RCC_ClockConfig(&RCC_ClkInitStruct, FLASH_LATENCY_0) != HAL_OK)
  {
    Error_Handler();
  }
}

/* USER CODE BEGIN 4 */
void pack32to16(int32_t * vectorIn, int16_t * vectorOut, uint32_t longitud)
{
	if(NULL == vectorIn || NULL == vectorOut)
	{
		return;
	}

	for(uint32_t i = longitud; i > 0U; i--)
	{
		vectorOut[i-1] = (uint16_t)(vectorIn[i-1] >> 16);
	}
}

uint32_t max(int32_t * vectorIn, uint32_t longitud)
{
	if(NULL == vectorIn)
	{
		return 0;
	}

	uint32_t max_pos = 0;
	int32_t max_val = vectorIn[0];

	for(uint32_t i = longitud; i > 0U; i--)
	{
		if(vectorIn[i-1] > max_val)
		{
			max_val = vectorIn[i-1];
			max_pos = (i-1);
		}
	}

	return max_pos;
}

void downSample(int32_t * vectorIn, int32_t * vectorOut, uint32_t longitud, uint32_t N)
{
	if(NULL == vectorIn || NULL == vectorOut || 0U == N)
	{
		return;
	}

	uint32_t itOut	= longitud - (longitud / N);

	for(uint32_t itIn = longitud; itIn > 0 ; itIn--)
	{
		if( 0U != (itIn % N))
		{
			vectorOut[itOut - 1] = vectorIn[itIn - 1];
			itOut--;
		}
	}
}

void invertir(uint16_t * vector, uint32_t longitud)
{
	uint16_t temp1 = 0;
	uint16_t temp2 = 0;

	// con esta condición, en el valor central de los impares hace el swap con sigo mismo
	for(uint32_t i = longitud; i > (longitud / 2); i--)
	{
		temp1 = vector[longitud - i];
		temp2 = vector[i - 1];

		vector[longitud - i] = temp2;
		vector[i - 1] 		 = temp1;
	}
}
/* USER CODE END 4 */

void Error_Handler(void)
{
  __disable_irq();
  while (1)
  {
  }
}
